## package/batocera/core/batocera-splash/Config.in
```kconfig
config BR2_PACKAGE_BATOCERA_SPLASH
    bool "batocera-splash"
    help
      Installs the splash screen assets and boot-up scripts for Batocera.linux.
      Displays a static logo image with overlayed build version info.
```

## package/batocera/emulationstation/batocera-es-system/Config.in
```kconfig
config BR2_PACKAGE_BATOCERA_ES_SYSTEM
	bool "batocera-es-system"
	select BR2_PACKAGE_BATOCERA_LAUNCH
	help
	  Generates the es_system.cfg file and the roms folder, from the
	  curated system list in es_systems.yml:

	    Nintendo: NES, SNES, N64, GameCube, Wii, Wii U, Game Boy,
	      Game Boy Color, Game Boy Advance, Nintendo DS, 3DS
	    Sega: Master System, Mega Drive, Mega CD, 32X, Saturn,
	      Dreamcast
	    Sony: PlayStation, PlayStation 2, PlayStation 3,
	      PlayStation Portable, PlayStation Vita
	    Arcade & Ports: MAME, FBNeo, DOS, Ports
	    Other Environments: Install Other OS, Virtual Hard Disks,
	      VM Applications (QEMU) - see os_install/os_hdds/vm_apps
	    Desktop Apps: container_apps

	  See removed.txt in this package for every system this build
	  does not ship.
```

## package/batocera/emulationstation/es-theme-panthera/Config.in
```kconfig
config BR2_PACKAGE_ES_THEME_PANTHERA
	bool "es-theme-panthera"
	help
	  Panthera's own EmulationStation theme: a dark, basic-view-only
	  theme matching the boot splash colors (teal/purple glow on black).
```

## package/batocera/emulators/batocera-qemu/virtio-win-guest-tools/Config.in
```kconfig
config BR2_PACKAGE_VIRTIO_WIN_GUEST_TOOLS
	bool "virtio-win-guest-tools"
	help
	  The official VirtIO-Win "Guest Tools" installers (virtio-win-gt-x64.msi
	  and virtio-win-gt-x86.msi): VirtIO drivers plus the QEMU guest agent and
	  SPICE vdagent, bundled for one-click install inside a Windows guest.
	  Exposed to Windows VMs as a small virtual USB drive by the qemu
	  launcher.

	  https://github.com/virtio-win/kvm-guest-drivers-windows
```

## package/batocera/emulators/qemu/Config.in
```kconfig
config BR2_PACKAGE_BATOCERA_QEMU
	bool "qemu"
	select BR2_PACKAGE_QEMU
	select BR2_PACKAGE_QEMU_SYSTEM
	select BR2_PACKAGE_QEMU_SDL
	select BR2_PACKAGE_QEMU_SLIRP
	select BR2_PACKAGE_QEMU_TOOLS
	help
	  Run other operating systems and legacy platforms in a full
	  system virtual machine, via QEMU (KVM-accelerated when available,
	  falling back to software emulation otherwise).

	  https://www.qemu.org/
```

## package/batocera/libraries/faudio/Config.in
```kconfig
config BR2_PACKAGE_FAUDIO
	bool "faudio"
	select BR2_PACKAGE_SDL3
	select BR2_PACKAGE_GSTREAMER1
	select BR2_PACKAGE_GST1_PLUGINS_BASE
	depends on !BR2_STATIC_LIBS
	help
	  This is FAudio, an XAudio reimplementation that focuses solely on developing
	  fully accurate DirectX Audio runtime libraries for the FNA project, including
	  XAudio2, X3DAudio, XAPO, and XACT3.

	  Project Website: http://fna-xna.github.io/
```

## package/batocera/utils/appman/Config.in
```kconfig
config BR2_PACKAGE_APPMAN
	bool "appman"
	help
	  "AM"/AppMan is a portable, root-free manager for AppImages and
	  other portable programs: it installs, updates and integrates
	  them without touching the system image.

	  https://github.com/ivan-hc/AM
```

## package/batocera/utils/batocera-discloader/Config.in
```kconfig
config BR2_PACKAGE_BATOCERA_DISCLOADER
	bool "batocera-discloader"
	select BR2_PACKAGE_PYTHON3
	help
	  Install a game straight off a physical disc: on insert, mounts it, reads its
	  play.txt/.m3u convention to find the one game at its root, and copies it into the
	  right system's roms folder. Discs with more than one game on them are left mounted
	  for the disc picker (batocera-disc-picker) instead of being guessed at.
```

## package/batocera/utils/batocera-home/Config.in
```kconfig
config BR2_PACKAGE_BATOCERA_HOME
	bool "batocera-home"
	select BR2_PACKAGE_PYTHON3
	select BR2_PACKAGE_PYTHON_EVDEV
	select BR2_PACKAGE_PYTHON_PSUTIL
	select BR2_PACKAGE_PYTHON_PYGAME2
	select BR2_PACKAGE_PYTHON_DBUS_FAST		# controls limusic over MPRIS from Home's Music view
	select BR2_PACKAGE_PYTHON_AIOHTTP		# downloads limusic's own album art
	help
	  Home: holds the gamepad Guide button (or the keyboard Home key) as a pause/resume
	  hotkey for every emulator, independent of whatever quit hotkey that emulator's own
	  config happens to have. Freezes the whole running process tree (SIGSTOP/SIGCONT) and
	  shows a Resume/Quit screen while it's frozen, with a Music view to control the
	  background Limusic player (see the "limusic" package/service).

	  EmulationStation's own Start/Space menu (see batocera-emulationstation's
	  GuiMenu title patch) is branded "HOME" too, so both entry points read as one
	  consistent system - EmulationStation still does all the actual menu work
	  (settings, scraper, network, etc.) unchanged, this package doesn't touch any
	  of that.
```

## package/batocera/utils/batocera-pause/Config.in
```kconfig
config BR2_PACKAGE_BATOCERA_PAUSE
	bool "batocera-pause"
	select BR2_PACKAGE_PYTHON3
	select BR2_PACKAGE_PYTHON_EVDEV
	select BR2_PACKAGE_PYTHON_PSUTIL
	select BR2_PACKAGE_PYTHON_PYGAME2
	select BR2_PACKAGE_PYTHON_DBUS_FAST		# controls limusic over MPRIS from the pause overlay's Music view
	select BR2_PACKAGE_PYTHON_AIOHTTP		# downloads limusic's own album art
	help
	  A universal pause: holds the gamepad Guide button (or the keyboard Home key) as a
	  pause/resume hotkey for every emulator, independent of whatever quit hotkey that
	  emulator's own config happens to have. Freezes the whole running process tree
	  (SIGSTOP/SIGCONT) and shows a Resume/Quit screen while it's frozen, with a Music
	  view to control the background Limusic player (see the "limusic" package/service).
```

## package/batocera/utils/batocera-podman/Config.in
```kconfig
config BR2_PACKAGE_BATOCERA_PODMAN
	bool "podman"
	select BR2_PACKAGE_PODMAN
	help
	  Run OCI container images (rootful) as a way to get full Linux
	  desktop apps - with their own library stack - without touching the
	  read-only system image. Used by the "container_apps" system to run
	  a shared desktop-apps image (openbox + picom + Brave) with USB,
	  Bluetooth, webcam, GPU and network passthrough.

	  https://podman.io/
```

## package/batocera/utils/limusic/Config.in
```kconfig
config BR2_PACKAGE_LIMUSIC
	bool "limusic (background music)"
	select BR2_PACKAGE_BATOCERA_PODMAN
	help
	  Builds the shared desktop-apps OCI image (openbox + picom + Brave
	  + Limusic - see containers/desktop-apps/) with the host's own
	  podman at build time and embeds it into the rootfs, then installs
	  a background service ("limusic") that loads the image once and
	  launches Limusic unmapped/backgrounded - the system's background
	  music, replacing EmulationStation's own (see es-background-musics
	  / audio.bgmusic in batocera.conf).

	  https://github.com/SimoHypers/limusic
```

## package/batocera/utils/panthera-shop/Config.in
```kconfig
config BR2_PACKAGE_PANTHERA_SHOP
	bool "panthera-shop"
	select BR2_PACKAGE_PYTHON3_SQLITE
	help
	  Game Downloader: a fork of RGSX (github.com/RetroGameSets/RGSX),
	  re-themed and rebranded, launched from the in-game Home overlay
	  rather than as a Ports entry. See batocera-home's "Game Downloader"
	  option.

	  https://github.com/theskysanctum/RGSX
```

## package/batocera/utils/stremio/Config.in
```kconfig
config BR2_PACKAGE_STREMIO
	bool "stremio (media center)"
	select BR2_PACKAGE_BATOCERA_PODMAN
	help
	  Installs a batocera-stremio wrapper, launched from ES's own HOME menu
	  (where Kodi used to be - see ApiSystem::launchKodi), that runs
	  Stremio - the next-gen media center - via the existing container_apps
	  system inside the shared desktop-apps OCI image (openbox + picom +
	  Brave + Limusic + Stremio - see containers/desktop-apps/) that
	  limusic already builds, embeds and loads.

	  https://github.com/Stremio/stremio-shell
```
